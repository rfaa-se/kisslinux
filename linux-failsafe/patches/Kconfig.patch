## linux-failsafe/patches/Kconfig.patch
```kconfig
diff --git a/lib/fonts/Kconfig b/lib/fonts/Kconfig
index c035fde..66e9d10 100644
--- a/lib/fonts/Kconfig
+++ b/lib/fonts/Kconfig
@@ -125,9 +125,19 @@ config FONT_6x8
 	help
 	  This font is useful for small displays (OLED).
 
+config FONT_LEMON
+	bool "LEMON 5x10 font (not supported by all drivers)"
+	depends on FRAMEBUFFER_CONSOLE && (!SPARC && FONTS || SPARC)
+	help
+	  Lemon is a clean, fixed width bitmap font, designed
+	  for long (8 and more hours per day) work with computers.
+	  This is the high resolution, large version for use with HiDPI screens.
+	  If the standard font is unreadable for you, say Y, otherwise say N.
+
 config FONT_AUTOSELECT
 	def_bool y
 	depends on !FONT_8x8
+	depends on !FONT_8x16
 	depends on !FONT_6x11
 	depends on !FONT_7x14
 	depends on !FONT_PEARL_8x8
@@ -139,6 +149,6 @@ config FONT_AUTOSELECT
 	depends on !FONT_10x18
 	depends on !FONT_TER16x32
 	depends on !FONT_6x8
-	select FONT_8x16
+	select FONT_LEMON
 
 endif # FONT_SUPPORT
```

## linux/patches/Kconfig.patch
```kconfig
diff --git a/lib/fonts/Kconfig b/lib/fonts/Kconfig
index 7d03823e4..f2e08a350 100644
--- a/lib/fonts/Kconfig
+++ b/lib/fonts/Kconfig
@@ -139,6 +139,13 @@ config FONT_6x8
 	help
 	  This font is useful for small displays (OLED).
 
+config FONT_LEMON
+	bool "LEMON 5x10 font" if FONTS
+	depends on FRAMEBUFFER_CONSOLE || DRM_PANIC
+	help
+	  Lemon is a clean, fixed width, bitmap font,
+	  useful for small displays.
+
 config FONT_AUTOSELECT
 	def_bool y
 	depends on !FONT_8x8
@@ -154,6 +161,7 @@ config FONT_AUTOSELECT
 	depends on !FONT_TER10x18
 	depends on !FONT_TER16x32
 	depends on !FONT_6x8
-	select FONT_8x16
+	depends on !FONT_8x16
+	select FONT_LEMON
 
 endif # FONT_SUPPORT
```
